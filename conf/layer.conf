## conf/layer.conf
```bitbake
# LAYER.conf

# Use in BBLAYERS.CONF following poky/meta and poky/meta-poky
# such that the prepend places this layer at the front of BBPATH

BBPATH =. "${LAYERDIR}:"

BBFILES += "${LAYERDIR}/recipes-*/*/*.bb ${LAYERDIR}/recipes-*/*/*.bbappend"

BBFILE_COLLECTIONS += "distro-com-cexpress-sl"
BBFILE_PATTERN_distro-com-cexpress-sl = "^${LAYERDIR}/"
BBFILE_PRIORITY_distro-com-cexpress-sl = "12"

# Requied dependency layers that are present in every build
LAYERDEPENDS_distro-com-cexpress-sl = "distro-core"
LAYERSERIES_COMPAT_distro-com-cexpress-sl = "kirkstone scarthgap"
```
